## config/west.yml
```yaml
manifest:
  remotes:
    - name: zmkfirmware
      url-base: https://github.com/zmkfirmware
    - name: lily58
      url-base: https://github.com

  projects:
    - name: zmk
      remote: zmkfirmware
      revision: main
      import: app

    - name: zmk-config-lily58
      remote: lily58
      revision: main

  self:
    path: config
```
